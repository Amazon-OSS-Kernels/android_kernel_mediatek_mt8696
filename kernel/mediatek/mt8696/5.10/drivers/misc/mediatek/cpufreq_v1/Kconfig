## kernel/mediatek/mt8696/5.10/drivers/misc/mediatek/cpufreq_v1/Kconfig
```kconfig
config MEDIATEK_CPUFREQ_DEBUG
	tristate "Mediatek cpu dvfs debug driver"
	help
	  This kernel config can be used to debug cpu dvfs (dynamic voltage
	  and frequency scaling) for Mediatek cpufreq driver.
	  When enable this option, we can dump the dvfs log and check
	  physical frequency
          If unsure, say N.

config MEDIATEK_EEM_DEBUG
	bool "MediaTek EEM debug driver"
	depends on MEDIATEK_CPUFREQ_DEBUG
	help
	  This kernel config can be used to debug eem feature
          If unsure, say N.
```

## kernel/mediatek/mt8696/5.10/drivers/misc/mediatek/debugfs_creator/Kconfig
```kconfig
config MTK_DEBUGFS_CREATOR
	tristate "build debugfs creator"
	depends on DEBUG_FS && ARCH_MEDIATEK
	help
	  This module is used for help all kernel modules create debugfs file
```

## kernel/mediatek/mt8696/5.10/drivers/misc/mediatek/power/Kconfig
```kconfig
config MTK_DUMMY_BATTERY
	tristate "MediaTek Dummy Battery Support"
	help
	  MediaTek Dummy Battery Driver
```

## vendor/amazon/bluetooth/mediatek/mt76xx/driver/mt76x8/usb/Kconfig
```kconfig
menu "btmtk"

config BTMTK_76X2T
        tristate "Mediatek Bluetooth driver mtk76x2t."
        depends on USB
        default m
        help
          Mediatek btusb driver mtk76x2t

endmenu
```
