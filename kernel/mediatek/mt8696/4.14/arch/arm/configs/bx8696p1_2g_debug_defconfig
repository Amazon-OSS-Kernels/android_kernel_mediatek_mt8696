## kernel/mediatek/mt8696/5.10/arch/arm64/configs/bx8696m1_k64_defconfig
```kconfig
CONFIG_BUILD_CONFIG_FILE="build.config.mtk.aarch64"
CONFIG_ARCH_MEDIATEK=y
CONFIG_PM_DEBUG=y
CONFIG_MTK_SRCLKEN_RC_V1=y
CONFIG_MTK_DVFSRC_HELPER=y
CONFIG_MTK_DVFSRC_MET_MT8696=y
CONFIG_THERMAL_EMERGENCY_POWEROFF_DELAY_MS=100
CONFIG_THERMAL_WRITABLE_TRIPS=y
CONFIG_THERMAL_DEFAULT_GOV_POWER_ALLOCATOR=y
CONFIG_CPU_THERMAL=y
CONFIG_DEVFREQ_THERMAL=y
CONFIG_THERMAL_EMULATION=y
CONFIG_MTK_BATTERY_OC_POWER_THROTTLING=m
CONFIG_MTK_LOW_BATTERY_POWER_THROTTLING=m
CONFIG_MTK_DUMMY_BATTERY=y
CONFIG_MTK_IOMMU_MISC=y
CONFIG_MTK_IOMMU_MISC_SECURE=y
CONFIG_MTK_CMDQ_MBOX_EXT=y
CONFIG_MTK_HDMI_SUPPORT=y
CONFIG_MTK_INTERNAL_HDMI_SUPPORT=y
CONFIG_MTK_HDMI_HDCP_SUPPORT=y
CONFIG_MTK_MDP=y
CONFIG_MTK_FB=y
CONFIG_MTK_LCM_PHYSICAL_ROTATION="0"
CONFIG_MTK_HDR10PLUS_SUPPORT=y
CONFIG_DOVI_SUPPORT=y
# CONFIG_DOVI_UT_SUPPORT is not set
CONFIG_ANDROID=y
CONFIG_TEE=y
CONFIG_OPTEE=y
CONFIG_EXT4_FS=y
CONFIG_EXT4_FS_SECURITY=y
CONFIG_EXT4_ENCRYPTION=y
CONFIG_MTK_TEE_GP_SUPPORT=y
CONFIG_DEFAULT_HUNG_TASK_TIMEOUT=0
# CONFIG_MTK_APUSYS_DEBUG is not set
# CONFIG_MTK_APUSYS_VPU_DEBUG is not set
# CONFIG_MTK_APUSYS_MDLA_SUPPORT is not set
# CONFIG_MTK_APUSYS_VPU is not set
CONFIG_MTK_AEE_FEATURE=y
CONFIG_MTK_AEE_AED=y
CONFIG_MTK_AEE_IPANIC=y
CONFIG_MTK_AEE_HWT_BACKTO_KERNEL=y
CONFIG_MTK_DRAM_LOG_STORE=y
CONFIG_MTK_DRAM_LOG_STORE_ADDR=0x0010DF00
CONFIG_MTK_DRAM_LOG_STORE_SIZE=0x100
CONFIG_PSTORE=y
CONFIG_PSTORE_CONSOLE=y
CONFIG_PSTORE_PMSG=y
CONFIG_PSTORE_RAM=y
CONFIG_MTPROF=y
CONFIG_MTK_DHCPV6C_WIFI=y
# CONFIG_MTK_CONN_LTE_IDC_SUPPORT is not set
CONFIG_MTK_GPS_EMI=m
CONFIG_MTK_FMRADIO=m
CONFIG_MTK_FM_CHIP="MT6635_FM"
CONFIG_RT_REGMAP=y
CONFIG_TCPC_CLASS=y
CONFIG_USB_POWER_DELIVERY=y
CONFIG_TCPC_RT1711H=y
CONFIG_EXTCON_MTK_USB=y
CONFIG_MTK_BUS_TRACER=y
CONFIG_MTK_DEBUG_TRACER=y
CONFIG_TYPEC_MUX_IT5205=y
CONFIG_MTK_USB_TYPEC_MUX=y
CONFIG_KEYBOARD_GPIO=y
CONFIG_KEYBOARD_MTK=y
CONFIG_KPD_PWRKEY_USE_PMIC=y
CONFIG_SERIAL_8250=y
CONFIG_SERIAL_8250_CONSOLE=y
CONFIG_SERIAL_8250_MT6577=y
CONFIG_I2C_MT65XX=y
CONFIG_I2C_HID=y
# CONFIG_SPI is not set
CONFIG_SPMI_MTK_PMIF=y
# CONFIG_PINCTRL_MT2712 is not set
# CONFIG_PINCTRL_MT6797 is not set
CONFIG_MTK_IRRX=y
CONFIG_MTK_IRRX_NEC=y
# CONFIG_PINCTRL_MT6779 is not set
# CONFIG_PINCTRL_MT6885 is not set
# CONFIG_PINCTRL_MT6983 is not set
# CONFIG_PINCTRL_MT7622 is not set
# CONFIG_PINCTRL_MT8167 is not set
# CONFIG_PINCTRL_MT8173 is not set
# CONFIG_PINCTRL_MT8183 is not set
# CONFIG_PINCTRL_MT8192 is not set
# CONFIG_PINCTRL_MT8188 is not set
# CONFIG_PINCTRL_MT8516 is not set
# CONFIG_PINCTRL_MT6397 is not set
CONFIG_PINCTRL_MT8696=y
CONFIG_GPIO_SYSFS=y
CONFIG_HAVE_MTK_MC=y
CONFIG_MTK_DRAMC=y
CONFIG_MTK_EMI=y
CONFIG_REBOOT_MODE=y
CONFIG_SYSCON_REBOOT_MODE=y
CONFIG_CHARGER_MT6360=m
# CONFIG_MTK_CHARGER_TYPE_DETECT=m
# CONFIG_MTK_CHARGER=m
CONFIG_CHARGER_RT9471=y
CONFIG_MTK_PERF_TRACKER=y
CONFIG_MTK_PUMP_EXPRESS_40_SUPPORT=m
CONFIG_MTK_THERMAL=y
CONFIG_MTK_SOC_THERMAL_LVTS=y
CONFIG_MTK_PMIC_THERMAL=y
CONFIG_GENERIC_ADC_THERMAL=y
CONFIG_MEDIATEK_WATCHDOG=y
CONFIG_MTK_SYSTRACKER_V2=y
CONFIG_MFD_MTK_SPMI_PMIC=m
CONFIG_RC_CORE=y
CONFIG_LIRC=y
# CONFIG_REGULATOR_MT6315 is not set
# CONFIG_REGULATOR_MT6359 is not set
# CONFIG_REGULATOR_MT6360 is not set
CONFIG_REGULATOR=y
CONFIG_REGULATOR_FIXED_VOLTAGE=y
CONFIG_REGULATOR_GPIO=y
CONFIG_REGULATOR_MT6395=y
CONFIG_REGULATOR_RT5738=y
CONFIG_REGULATOR_MTK_DVFSRC=y
CONFIG_MTK_SECURITY_SW_SUPPORT=m
CONFIG_ROGUE_GE9215=y
CONFIG_SND_SOC_MT8696=y
CONFIG_SND_SOC_MT8696_EVB=y
CONFIG_SND_SOC_MT8532=y
CONFIG_SND_SOC_MT8532_EVB=y
CONFIG_SND_SOC_EARC_RX=y
CONFIG_USB_MTU3=y
CONFIG_NEW_LEDS=y
CONFIG_LEDS_CLASS=y
CONFIG_LEDS_PWM=y
CONFIG_LEDS_REGULATOR_VIBRATOR=m
CONFIG_LEDS_MT6360=m
CONFIG_MTK_FLASHLIGHT=m
CONFIG_MTK_V4L2_FLASHLIGHT=m
CONFIG_V4L2_FLASH_LED_CLASS=m
CONFIG_MTK_UART_APDMA=m
CONFIG_DMABUF_HEAPS=y
CONFIG_DMABUF_HEAPS_DEFERRED_FREE=y
CONFIG_DMABUF_HEAPS_PAGE_POOL=y
CONFIG_DMABUF_HEAPS_SYSTEM=y
CONFIG_DMABUF_HEAPS_MTK_MM=y
CONFIG_DMABUF_HEAPS_MTK_SVP=y
CONFIG_DMABUF_HEAPS_DEBUG=y
CONFIG_STAGING=y
CONFIG_ION=y
CONFIG_ION_SYSTEM_HEAP=y
CONFIG_MTK_ION_MM_HEAP=y
CONFIG_MTK_ION_SEC_HEAP=y
CONFIG_MTK_IOMMU=y
CONFIG_MTK_IOMMU_MT8XXX=y
CONFIG_MTK_DVFSRC=y
CONFIG_MTK_SCHEDULER=y
CONFIG_MTK_EAS=y
CONFIG_MTK_NEWIDLE_BALANCE=y
CONFIG_MTK_SCPSYS=y
CONFIG_MTK_IPI=y
CONFIG_MTK_MBOX=y
CONFIG_MTK_SVS=y
CONFIG_RPMSG_MTK=y
CONFIG_HW_RANDOM_SECURE=m
CONFIG_MTK_DVFSRC_DEVFREQ=y
CONFIG_MEDIATEK_MT635X_AUXADC=y
CONFIG_MEDIATEK_MT6577_AUXADC=y
CONFIG_PCIE_MEDIATEK_GEN3=y
CONFIG_ARM_MEDIATEK_CPUFREQ_HW=y
CONFIG_PWM=y
CONFIG_PWM_MTK_DISP=y
CONFIG_RESET_CONTROLLER=y
CONFIG_RESET_TI_SYSCON=y
CONFIG_PHY_MTK_TPHY=y
CONFIG_MTK_DEVINFO=y
CONFIG_MT6359_EFUSE=y
CONFIG_MTK_QOS_FRAMEWORK=y
CONFIG_MTK_PRINTK_UART_CONSOLE=y
CONFIG_MTK_PRINTK=y
CONFIG_MTK_CAMERA_ISP_PLATFORM="mt6893"
CONFIG_VIDEO_DEV=y
CONFIG_V4L2_FWNODE=y
CONFIG_MTK_CCD_REMOTEPROC=y
CONFIG_VIDEO_MTK_ISP_CAMSYS=y
CONFIG_VIDEO_MTK_AIE=y
CONFIG_VIDEO_MTK_ISP_HCP=y
CONFIG_VIDEO_MTK_ISP_IMGSYS=y
CONFIG_VIDEO_MTK_ISP_IPESYS=y
CONFIG_CUSTOM_KERNEL_IMGSENSOR=
#CONFIG_MTK_IMGSENSOR=y
CONFIG_MTK_IMGSENSOR_PLATFORM_SUPPORT=y
CONFIG_MTK_IMGSENSOR_MT6893=y
CONFIG_MTK_VOW_DSP_VERSION="ver02"
CONFIG_MTK_CCU=m
CONFIG_MTK_LOW_POWER_MODULE=y
CONFIG_MTK_SWPM_PERF_ARMV8_PMU=m
# CONFIG_MTK_MMDVFS is not set
CONFIG_MTK_MMSYS=y
CONFIG_ZSMALLOC=y
CONFIG_ZRAM=y
CONFIG_MTK_TINYSYS_MCUPM_SUPPORT=y
# CONFIG_MTK_SENSOR_SUPPORT is not set
# CONFIG_MTK_SENSOR_ARCHITECTURE is not set
CONFIG_MTK_SLBC_MMSRAM=y
# CONFIG_CUSTOM_KERNEL_ACCELEROMETER is not set
CONFIG_MTK_MC34XX=y
CONFIG_MTK_LTR559=y
CONFIG_MTK_HWMON=y
CONFIG_MTK_CM_MGR=y
CONFIG_MMC_MTK=y
CONFIG_PWRSEQ_SIMPLE=y
CONFIG_MMC_MTK_SDIO=y
CONFIG_MMC_CQHCI=y
CONFIG_MTK_FPSGO_V3=y
CONFIG_MTK_PERFORMANCE_MODULE=y
CONFIG_MTK_ATF_LOGGER=y
CONFIG_MTK_ICE_DEBUG=y
CONFIG_VIDEO_MEDIATEK_VCODEC=y
CONFIG_VIDEO_MEDIATEK_VCU=y
CONFIG_VIDEO_MEDIATEK_VCU_WO_FUSE=y
CONFIG_VB2_MEDIATEK_DMA=y
CONFIG_VIDEO_MEDIATEK_VCODEC_V2=y
# CONFIG_VIDEO_MEDIATEK_JPEG is not set
CONFIG_MEDIA_SUPPORT=y
CONFIG_MEDIA_PLATFORM_SUPPORT=y
CONFIG_V4L_MEM2MEM_DRIVERS=y
CONFIG_MTK_SEC_VIDEO_PATH_SUPPORT=y
CONFIG_BACKLIGHT_LCD_SUPPORT=y
CONFIG_LCD_CLASS_DEVICE=y
CONFIG_BACKLIGHT_PWM=y
CONFIG_LOGO=y
CONFIG_MTK_SOCINFO=m
CONFIG_ARM_DSU_PMU=y
CONFIG_MTK_CAM_CAL=m
CONFIG_MTK_DBGTOP=y
CONFIG_MTK_JPEG=m
CONFIG_MTK_SDA=y
CONFIG_MTK_IRQ_DBG=y
CONFIG_MTK_LASTPC=y
CONFIG_AUDIO_ASRC_COMMON=y
# CONFIG_COMMON_CLK_MT8188 is not set
# CONFIG_COMMON_CLK_MT8188_AUDSYS is not set
# CONFIG_COMMON_CLK_MT8188_AUDSYS_SRC is not set
# CONFIG_COMMON_CLK_MT8188_CAMSYS is not set
# CONFIG_COMMON_CLK_MT8188_IMGSYS is not set
# CONFIG_COMMON_CLK_MT8188_IMP_IIC_WRAP is not set
# CONFIG_COMMON_CLK_MT8188_IPESYS is not set
# CONFIG_COMMON_CLK_MT8188_VDECSYS is not set
# CONFIG_COMMON_CLK_MT8188_VDOSYS0 is not set
# CONFIG_COMMON_CLK_MT8188_VDOSYS1 is not set
# CONFIG_COMMON_CLK_MT8188_VENCSYS is not set
# CONFIG_COMMON_CLK_MT8188_VPPSYS0 is not set
# CONFIG_COMMON_CLK_MT8188_VPPSYS1 is not set
# CONFIG_COMMON_CLK_MT8188_WPESYS is not set
# CONFIG_COMMON_CLK_MT8188_CCUSYS is not set
# CONFIG_COMMON_CLK_MT8188_MFGCFG is not set
CONFIG_COMMON_CLK_MT8696=y
CONFIG_COMMON_CLK_MT8696_ETHER=y
CONFIG_COMMON_CLK_MT8696_IMGSYS=y
CONFIG_COMMON_CLK_MT8696_MMSYS=y
CONFIG_COMMON_CLK_MT8696_NNA=y
CONFIG_COMMON_CLK_MT8696_VDEC=y
CONFIG_COMMON_CLK_MT8696_VDEC_SOC=y
CONFIG_COMMON_CLK_MT8696_VENC=y
CONFIG_COMMON_CLK_MTK_FREQ_HOPPING=y
CONFIG_COMMON_CLK_MTK_FREQ_HOPPING_MCUPM=y
CONFIG_MTK_SCPSYS_PM_DOMAINS=y
# CONFIG_ARM64_BTI is not set
CONFIG_MTK_COMBO_CHIP_MT7921=y
# CONFIG_BT_HCIBTSDIO is not set
CONFIG_MTK_COMBO_WIFI=y
CONFIG_EXTCON_USB_GPIO=y
CONFIG_CFG80211=y
CONFIG_NL80211_TESTMODE=y
CONFIG_CFG80211_DEVELOPER_WARNINGS=y
CONFIG_CFG80211_INTERNAL_REGDB=y
# CONFIG_LTO_CLANG_FULL is not set
CONFIG_USB_CONFIGFS_F_MTP=y
CONFIG_USB_CONFIGFS_F_UVC=y
CONFIG_MTK_STC=y
CONFIG_MTK_DEBUGFS_CREATOR=y
CONFIG_MTK_MET=m
CONFIG_MTK_MET_RESERVED_MEM_BY_TINYSYS=y
CONFIG_MTK_MET_SSPM_LEGACY_IPI=y
# CONFIG_MTK_TINYSYS_SCP_SUPPORT is not set
# CONFIG_MTK_TINYSYS_SCP_LOGGER_SUPPORT is not set
# CONFIG_MTK_TINYSYS_SSPM_SUPPORT is not set
# CONFIG_MTK_TINYSYS_SSPM_V2 is not set
CONFIG_MTK_VQ=y
CONFIG_MTK_SECURE_EFUSE=y
CONFIG_NET=y
CONFIG_NETDEVICES=y
CONFIG_NET_VENDOR_MEDIATEK=y
CONFIG_NET_MEDIATEK_STAR_EMAC=y
CONFIG_MEDIATEK_ETH_DEBUG=y
CONFIG_REALTEK_PHY=y
# CONFIG_BLK_DEBUG_FS is not set
CONFIG_CRYPTO_AES_ARM64=y
CONFIG_CRYPTO_AES_ARM64_BS=y
CONFIG_CRC_ITU_T=y
CONFIG_CRC7=y
CONFIG_CRYPTO_LZ4HC=y
# CONFIG_TRANSPARENT_HUGEPAGE is not set
# CONFIG_TRANSPARENT_HUGEPAGE_MADVISE is not set
```
