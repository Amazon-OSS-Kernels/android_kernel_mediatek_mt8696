## kernel/mediatek/mt8696/4.14/arch/arm/configs/kara_debug_defconfig
```kconfig
CONFIG_CROSS_COMPILE="aarch64-linux-android-"
# CONFIG_LOCALVERSION_AUTO is not set
# CONFIG_FHANDLE is not set
CONFIG_CPUSETS=y
CONFIG_SYSCTL_SYSCALL=y
CONFIG_KALLSYMS_ALL=y
CONFIG_SLUB_DEBUG=y
CONFIG_SLUB_DEBUG_ON=y
CONFIG_CC_STACKPROTECTOR_STRONG=y
# CONFIG_BLK_DEV_BSG is not set
CONFIG_ARCH_MEDIATEK=y
CONFIG_SMP=y
CONFIG_SCHED_MC=y
CONFIG_HAVE_ARM_ARCH_TIMER=y
CONFIG_ARM_PSCI=y
CONFIG_PREEMPT=y
CONFIG_HIGHMEM=y
CONFIG_KSM=y
# CONFIG_ZONE_MOVABLE_CMA is not set
CONFIG_ZSMALLOC=y
CONFIG_BUILD_ARM_APPENDED_DTB_IMAGE=y
CONFIG_BUILD_ARM_APPENDED_DTB_IMAGE_NAMES="kara"
CONFIG_CMDLINE="console=tty0 console=ttyMT0,921600n1 root=/dev/ram loglevel=8 initcall_debug"
CONFIG_CPU_FREQ=y
CONFIG_CPU_FREQ_STAT=y
CONFIG_CPU_FREQ_GOV_POWERSAVE=y
CONFIG_CPU_FREQ_GOV_USERSPACE=y
CONFIG_CPU_FREQ_GOV_ONDEMAND=y
CONFIG_CPU_FREQ_GOV_SCHEDUTIL=y
# CONFIG_CPUFREQ_DT=y
CONFIG_CPU_IDLE=y
CONFIG_ARM_CPUIDLE=y
# CONFIG_CORE_DUMP_DEFAULT_ELF_HEADERS is not set
CONFIG_PM_DEBUG=y
CONFIG_PM_ADVANCED_DEBUG=y
CONFIG_PM_SKIP_PENDING_WAKEUP=y
CONFIG_XFRM_MIGRATE=y
CONFIG_IP_PNP=y
CONFIG_IP_PNP_DHCP=y
CONFIG_IP_PNP_BOOTP=y
CONFIG_NET_IPIP=y
CONFIG_NET_IPGRE_DEMUX=y
CONFIG_IP_MROUTE=y
CONFIG_IP_MROUTE_MULTIPLE_TABLES=y
CONFIG_IP_PIMSM_V1=y
CONFIG_IP_PIMSM_V2=y
CONFIG_SYN_COOKIES=y
CONFIG_INET_AH=y
CONFIG_INET_IPCOMP=y
CONFIG_INET6_AH=y
CONFIG_INET6_XFRM_MODE_ROUTEOPTIMIZATION=y
CONFIG_IPV6_SIT_6RD=y
CONFIG_IPV6_SUBTREES=y
CONFIG_IPV6_MROUTE=y
CONFIG_IPV6_PIMSM_V2=y
CONFIG_BRIDGE_NETFILTER=y
CONFIG_NETFILTER_XT_TARGET_CT=y
CONFIG_NETFILTER_XT_MATCH_CONNBYTES=y
CONFIG_NETFILTER_XT_MATCH_MULTIPORT=y
CONFIG_NETFILTER_XT_MATCH_PHYSDEV=y
CONFIG_NETFILTER_XT_MATCH_REALM=y
CONFIG_NETFILTER_XT_MATCH_RECENT=y
CONFIG_NETFILTER_XT_MATCH_TCPMSS=y
CONFIG_NF_CONNTRACK=y
CONFIG_NF_CT_NETLINK=y
CONFIG_NF_CONNTRACK_EVENTS=y
CONFIG_NF_CONNTRACK_TIMESTAMP=y
CONFIG_NETFILTER_ADVANCED=y
CONFIG_NETFILTER_NETLINK_ACCT=y
CONFIG_NETFILTER_NETLINK_LOG=y
CONFIG_IP_NF_MATCH_AH=y
CONFIG_IP6_NF_MATCH_FRAG=y
CONFIG_IP6_NF_MATCH_IPV6HEADER=y
CONFIG_IP6_NF_TARGET_HL=y
CONFIG_L2TP=y
CONFIG_BRIDGE=y
CONFIG_VLAN_8021Q=y
CONFIG_NET_SCH_INGRESS=y
CONFIG_NET_CLS_FW=y
CONFIG_CLS_U32_PERF=y
CONFIG_CLS_U32_MARK=y
CONFIG_NET_CLS_FLOW=y
CONFIG_NET_ACT_POLICE=y
CONFIG_NET_ACT_MIRRED=y
CONFIG_NET_ACT_IPT=y
CONFIG_NET_CLS_IND=y
CONFIG_BT=y
CONFIG_CFG80211=y
CONFIG_NL80211_TESTMODE=y
CONFIG_CFG80211_DEVELOPER_WARNINGS=y
# CONFIG_CFG80211_DEFAULT_PS is not set
CONFIG_CFG80211_DEBUGFS=y
CONFIG_CFG80211_INTERNAL_REGDB=y
# CONFIG_DMA_CMA=y
# CONFIG_CMA_SIZE_MBYTES=64
CONFIG_ZRAM=y
CONFIG_ZRAM_LZ4_COMPRESS=y
CONFIG_BLK_DEV_LOOP=y
CONFIG_IDME=y
CONFIG_USB_CH_TYPE_SYSFS=y
CONFIG_MEDIATEK_SOLUTION=y
CONFIG_MTK_PLATFORM="mt8696"
CONFIG_ARCH_MTK_PROJECT="kara"
CONFIG_MTK_ENG_BUILD=y
CONFIG_MTK_GPT_SCHEME_SUPPORT=y
CONFIG_MTK_BASE_POWER=y
CONFIG_MTK_CPU_FREQ=y
CONFIG_MTK_PTPOD=y
CONFIG_MTK_STATIC_POWER=y
CONFIG_POWER_TABLE_MT8696=y
CONFIG_BTS_THERMISTOR=y
CONFIG_AMZN_THERMAL_COOLING=y
CONFIG_MTK_TINYSYS_MCUPM_SUPPORT=y
CONFIG_MTK_LOW_POWER_MODULE=y
CONFIG_MTK_SEC_VIDEO_PATH_SUPPORT=y
CONFIG_MTK_CMDQ=y
CONFIG_MTK_CMDQ_MBOX_EXT=y
CONFIG_MTK_HDMI_SUPPORT=y
CONFIG_MTK_INTERNAL_HDMI_SUPPORT=y
CONFIG_MTK_HDMI_HDCP_SUPPORT=y
CONFIG_MTK_HDMI_POLARITY_SWAP=y
CONFIG_MTK_FB=y
# CONFIG_MTK_LCM_PHYSICAL_ROTATION="0"
# CONFIG_MMPROFILE is not set
CONFIG_MTK_MDP=y
CONFIG_MTK_CLI_DEBUG_SUPPORT=y
CONFIG_MTK_VQ=y
CONFIG_MTK_COMBO=y
CONFIG_MTK_COMBO_CHIP_MT7921=y
CONFIG_MTK_COMBO_WIFI=y
# CONFIG_MTK_CCCI_DEVICES is not set
CONFIG_MTK_TEE_GP_SUPPORT=y
CONFIG_MTK_SECURE_EFUSE=y
# CONFIG_MTK_AVB20_SUPPORT is not set
CONFIG_MTK_DRAMC=y
CONFIG_MTK_EMI=y
# CONFIG_MTK_M4U is not set
CONFIG_MTK_PSEUDO_M4U=y
# CONFIG_MTK_LENS_DUMMYLENS_SUPPORT=y
# CONFIG_MTK_LENS_WV511AAF_SUPPORT=y
CONFIG_MTK_IDLE_BALANCE_ENHANCEMENT=y
# CONFIG_MTK_SCHED_INTEROP is not set
CONFIG_MTK_RAM_CONSOLE=y
CONFIG_MTK_RAM_CONSOLE_USING_DRAM=y
CONFIG_MTK_RAM_CONSOLE_DRAM_SIZE=0x10000
CONFIG_MTK_RAM_CONSOLE_DRAM_ADDR=0x59400000
CONFIG_MTK_AEE_FEATURE=y
CONFIG_MTK_AEE_UT=y
CONFIG_ANDROID_DEFAULT_SETTING=y
CONFIG_MTK_SYNC=y
CONFIG_MTK_DEBUG_LATCH=y
CONFIG_MTK_LASTPC=y
CONFIG_MTK_SYSTRACKER_V2=y
CONFIG_MTK_STC=y
CONFIG_MTK_FD_LEAK_DETECT=y
# CONFIG_ACENNA=y
CONFIG_SCSI=y
CONFIG_BLK_DEV_SD=y
CONFIG_SCSI_SCAN_ASYNC=y
# CONFIG_SCSI_LOWLEVEL is not set
CONFIG_MD=y
CONFIG_BLK_DEV_MD=y
CONFIG_MD_LINEAR=y
CONFIG_BLK_DEV_DM=y
CONFIG_DM_DEBUG=y
CONFIG_DM_CRYPT=y
CONFIG_DM_UEVENT=y
CONFIG_DM_VERITY=y
CONFIG_DM_ANDROID_VERITY_AT_MOST_ONCE_DEFAULT_ENABLED=y
CONFIG_DM_VERITY_FEC=y
CONFIG_DM_ANDROID_VERITY=y
CONFIG_IFB=y
# CONFIG_ETHERNET is not set
CONFIG_PPP_FILTER=y
CONFIG_PPP_MULTILINK=y
CONFIG_PPPOE=y
CONFIG_PPTP=y
CONFIG_PPPOL2TP=y
CONFIG_PPP_ASYNC=y
CONFIG_PPP_SYNC_TTY=y
CONFIG_USB_RTL8152=y
CONFIG_USB_USBNET=y
CONFIG_USB_NET_SMSC95XX=y
CONFIG_INPUT_EVDEV=y
CONFIG_INPUT_TOUCHSCREEN=y
CONFIG_INPUT_MISC=y
CONFIG_INPUT_UINPUT=y
# CONFIG_VT is not set
CONFIG_LEGACY_PTY_COUNT=16
# CONFIG_DEVMEM is not set
CONFIG_SERIAL_8250=y
CONFIG_SERIAL_8250_CONSOLE=y
CONFIG_SERIAL_8250_MT6577=y
# CONFIG_HW_RANDOM is not set
CONFIG_I2C_CHARDEV=y
CONFIG_I2C_MT65XX=y
CONFIG_PINCTRL_MT8696=y
# CONFIG_PINCTRL_MT6397 is not set
# CONFIG_HWMON is not set
CONFIG_THERMAL=y
CONFIG_THERMAL_WRITABLE_TRIPS=y
CONFIG_THERMAL_DEFAULT_GOV_BACKWARD_COMPATIBLE=y
CONFIG_THERMAL_GOV_TRIP_STEP_WISE=y
CONFIG_CPU_THERMAL=y
CONFIG_CPUCORE_THERMAL=y
CONFIG_THERMAL_EMULATION=y
CONFIG_WIFI_THERMAL=y
CONFIG_GPU_THERMAL=y
CONFIG_THERMAL_VIRTUAL_SENSOR=y
CONFIG_WATCHDOG=y
CONFIG_MEDIATEK_WATCHDOG=y
# CONFIG_MTK_WATCHDOG is not set
# CONFIG_MTK_WD_KICKER is not set
# CONFIG_MFD_MT6397=y
CONFIG_REGULATOR=y
CONFIG_REGULATOR_FIXED_VOLTAGE=y
CONFIG_REGULATOR_GPIO=y
CONFIG_REGULATOR_MT6395=y
CONFIG_REGULATOR_RT5738=y
# CONFIG_RC_MAP is not set
CONFIG_LIRC=y
# CONFIG_IR_LIRC_CODEC is not set
# CONFIG_IR_NEC_DECODER is not set
# CONFIG_IR_RC5_DECODER is not set
# CONFIG_IR_RC6_DECODER is not set
# CONFIG_IR_JVC_DECODER is not set
# CONFIG_IR_SONY_DECODER is not set
# CONFIG_IR_SANYO_DECODER is not set
# CONFIG_IR_MCE_KBD_DECODER is not set
CONFIG_MEDIA_SUPPORT=y
CONFIG_MEDIA_CAMERA_SUPPORT=y
CONFIG_MEDIA_USB_SUPPORT=y
CONFIG_USB_VIDEO_CLASS=y
CONFIG_V4L_PLATFORM_DRIVERS=y
CONFIG_V4L_MEM2MEM_DRIVERS=y
CONFIG_VIDEO_MEDIATEK_VCU_WO_FUSE=y
CONFIG_VB2_MEDIATEK_DMA_CONTIG=y
CONFIG_VIDEO_MEDIATEK_VCODEC=y
CONFIG_ROGUE_GE9215=y
CONFIG_DRM=y
CONFIG_FB_MODE_HELPERS=y
CONFIG_FB_TILEBLITTING=y
CONFIG_LOGO=y
CONFIG_SOUND=y
CONFIG_SND=y
CONFIG_SND_HRTIMER=y
CONFIG_SND_DYNAMIC_MINORS=y
CONFIG_SND_VERBOSE_PRINTK=y
CONFIG_SND_DEBUG=y
CONFIG_SND_DEBUG_VERBOSE=y
CONFIG_SND_PCM_XRUN_DEBUG=y
CONFIG_SND_SEQUENCER=y
CONFIG_SND_SEQ_DUMMY=y
CONFIG_SND_USB_AUDIO=y
CONFIG_SND_SOC=y
CONFIG_SND_SOC_MT8696=y
CONFIG_SND_SOC_MT8696_EVB=y
CONFIG_SND_SOC_MT8532=y
CONFIG_SND_SOC_MT8532_EVB=y
CONFIG_SND_SOC_EARC_RX=y
CONFIG_SND_SIMPLE_CARD=y
CONFIG_HIDRAW=y
CONFIG_UHID=y
CONFIG_HID_A4TECH=y
CONFIG_HID_APPLE=y
CONFIG_HID_BELKIN=y
CONFIG_HID_CHERRY=y
CONFIG_HID_CHICONY=y
CONFIG_HID_CYPRESS=y
CONFIG_HID_DRAGONRISE=y
CONFIG_HID_EZKEY=y
CONFIG_HID_KYE=y
CONFIG_HID_GYRATION=y
CONFIG_HID_TWINHAN=y
CONFIG_HID_KENSINGTON=y
CONFIG_HID_LOGITECH=y
CONFIG_HID_MAGICMOUSE=y
CONFIG_HID_MICROSOFT=y
CONFIG_HID_MONTEREY=y
CONFIG_HID_PANTHERLORD=y
CONFIG_HID_PETALYNX=y
CONFIG_HID_SAMSUNG=y
CONFIG_HID_SUNPLUS=y
CONFIG_HID_GREENASIA=y
CONFIG_HID_SMARTJOYPLUS=y
CONFIG_HID_TOPSEED=y
CONFIG_HID_THRUSTMASTER=y
CONFIG_HID_ZEROPLUS=y
CONFIG_HID_FTV_BLEREMOTE=y
CONFIG_USB=y
CONFIG_USB_CH_TYPE_SYSFS=y
CONFIG_USB_XHCI_HCD=y
CONFIG_USB_XHCI_MTK_DEBUGFS=y
CONFIG_USB_STORAGE=y
CONFIG_USB_MTU3=y
CONFIG_MTU3_SUPPORT_Y_CABLE=y
CONFIG_USB_SERIAL=y
CONFIG_USB_SERIAL_OPTION=y
CONFIG_USB_TRANCEVIBRATOR=y
CONFIG_NOP_USB_XCEIV=y
CONFIG_DUAL_ROLE_USB_INTF=y
CONFIG_USB_CONFIGFS_SERIAL=y
CONFIG_USB_CONFIGFS_ACM=y
CONFIG_USB_CONFIGFS_RNDIS=y
CONFIG_USB_CONFIGFS_MASS_STORAGE=y
CONFIG_USB_CONFIGFS_F_MTP=y
CONFIG_USB_CONFIGFS_F_PTP=y
CONFIG_USB_CONFIGFS_F_HID=y
CONFIG_MMC=y
CONFIG_MMC_BLOCK_MINORS=32
CONFIG_MTK_EMMC_HW_CQ=y
CONFIG_MMC_MTK=y
CONFIG_MMC_MTK_SDIO=y
# CONFIG_RTC_SYSTOHC is not set
CONFIG_SW_SYNC=y
CONFIG_ANDROID_INTF_ALARM_DEV=y
CONFIG_ION=y
CONFIG_MTK_ION=y
CONFIG_AMAZON=y
CONFIG_AMAZON_METRICS_LOG=y
CONFIG_AMAZON_MINERVA_METRICS_LOG=y
CONFIG_AMAZON_SIGN_OF_LIFE=y
# CONFIG_COMMON_CLK_MT8173 is not set
# CONFIG_COMMON_CLK_MT8168 is not set
CONFIG_COMMON_CLK_MT8696_ETHER=y
CONFIG_COMMON_CLK_MT8696_IMGSYS=y
CONFIG_COMMON_CLK_MT8696_MMSYS=y
CONFIG_COMMON_CLK_MT8696_NNA=y
CONFIG_COMMON_CLK_MT8696_VDEC=y
CONFIG_COMMON_CLK_MT8696_VDEC_SOC=y
CONFIG_COMMON_CLK_MT8696_VENC=y
CONFIG_MAILBOX=y
CONFIG_MTK_CMDQ_MBOX=y
CONFIG_MTK_IOMMU=y
CONFIG_RPMSG_MTK=y
CONFIG_MTK_IPI=y
CONFIG_MTK_MBOX=y
CONFIG_EXTCON_USB_GPIO=y
CONFIG_IIO=y
CONFIG_MEDIATEK_MT6577_AUXADC=y
CONFIG_RESET_CONTROLLER=y
CONFIG_PHY_MTK_TPHY=y
CONFIG_ARM_DSU_PMU=y
CONFIG_MTK_EFUSE=y
CONFIG_TEE=y
CONFIG_OPTEE=y
CONFIG_EXT4_FS=y
CONFIG_EXT4_FS_SECURITY=y
CONFIG_EXT4_ENCRYPTION=y
CONFIG_EXT4_DEBUG=y
CONFIG_QUOTA=y
CONFIG_QUOTA_NETLINK_INTERFACE=y
CONFIG_QFMT_V2=y
CONFIG_FUSE_FS=y
CONFIG_MSDOS_FS=y
CONFIG_VFAT_FS=y
CONFIG_TMPFS=y
CONFIG_SDCARD_FS=y
CONFIG_PSTORE=y
CONFIG_PSTORE_CONSOLE=y
CONFIG_PSTORE_PMSG=y
CONFIG_PSTORE_RAM=y
CONFIG_PSTORE_CONSOLE_SIZE=0x40000
CONFIG_PSTORE_PMSG_SIZE=0x10000
CONFIG_PSTORE_MEM_ADDR=0x59410000
CONFIG_PSTORE_MEM_SIZE=0xe0000
# CONFIG_NETWORK_FILESYSTEMS is not set
CONFIG_NLS_CODEPAGE_437=y
CONFIG_NLS_CODEPAGE_950=y
CONFIG_NLS_ASCII=y
CONFIG_NLS_ISO8859_1=y
CONFIG_NLS_UTF8=y
CONFIG_PRINTK_TIME=y
CONFIG_DYNAMIC_DEBUG=y
CONFIG_DEBUG_INFO=y
CONFIG_FRAME_WARN=1400
CONFIG_DEBUG_KMEMLEAK=y
CONFIG_DEBUG_KMEMLEAK_EARLY_LOG_SIZE=2400
CONFIG_DEBUG_KMEMLEAK_DEFAULT_OFF=y
CONFIG_DEBUG_VIRTUAL=y
CONFIG_PANIC_ON_OOPS=y
CONFIG_PANIC_TIMEOUT=5
CONFIG_SCHEDSTATS=y
# CONFIG_DEBUG_PREEMPT is not set
CONFIG_DEBUG_RT_MUTEXES=y
CONFIG_DEBUG_SPINLOCK=y
CONFIG_DEBUG_MUTEXES=y
CONFIG_DEBUG_ATOMIC_SLEEP=y
CONFIG_DEBUG_LIST=y
CONFIG_RCU_CPU_STALL_TIMEOUT=60
CONFIG_FAULT_INJECTION=y
CONFIG_MTK_SCHED_TRACERS=y
CONFIG_DMA_API_DEBUG=y
# CONFIG_ARM_UNWIND is not set
CONFIG_SECURITY_SELINUX_BOOTPARAM=y
CONFIG_INTEGRITY_SIGNATURE=y
CONFIG_INTEGRITY_ASYMMETRIC_KEYS=y
CONFIG_CRYPTO_TWOFISH=y
# CONFIG_CRYPTO_HW is not set
CONFIG_SYSTEM_TRUSTED_KEYRING=y
CONFIG_SYSTEM_TRUSTED_KEYS="certs/amazon_verity.x509.pem"
CONFIG_OF=y
CONFIG_ARM_CRYPTO=y
CONFIG_CRYPTO_SHA2_ARM_CE=y
CONFIG_CRYPTO_AES_ARM=y
CONFIG_CRYPTO_AES_ARM_BS=y
CONFIG_CRYPTO_AES_ARM_CE=y
CONFIG_CRC_ITU_T=y
CONFIG_CRC7=y
CONFIG_MTK_DUMMY_BATTERY=y
CONFIG_POWER_SUPPLY=y
```

## kernel/mediatek/mt8696/4.14/drivers/misc/amazon/Kconfig
```kconfig
#
# Amazon Devices
#

config ACENNA
	tristate "ACENNA"
	default n
	help
	  This option enables support
	  the ACENNA accelerator.
	  If you are not sure, say N here.
```

## kernel/mediatek/mt8696/4.14/drivers/misc/mediatek/power/Kconfig
```kconfig
# Power Related
config MTK_PMIC
	bool "MediaTek PMIC driver"
	---help---
	  MediaTek PMIC driver

config MTK_DUMMY_BATTERY
	bool "MediaTek Dummy Battery Support"
	default n
	---help---
	  MediaTek Dummy Battery Driver
```

## kernel/mediatek/mt8696/4.14/drivers/misc/mediatek/thermal/Kconfig
```kconfig
config MTK_THERMAL_PA_VIA_ATCMD
	bool "Thermal switch for query modem RF temp"
	help
	  Internal switch for thermal management
	  to query modem RF temperature
	  via AT command.
	  (RIL sockets)

config BTS_THERMISTOR
	bool "ntc bts thermistor"
	default n
	help
	  Say Y here if you want to use the external ntc bts thermistor

config AMZN_THERMAL_COOLING
	bool "amzn thermal cooling"
	default n
	help
	  Use this to define what cooling devices to use and register
	  the cooling devices on Amazon platform
```

## kernel/mediatek/mt8696/4.14/drivers/misc/mediatek/vq/Kconfig
```kconfig
config MTK_VQ
	tristate "use di for deinterlace"
	bool "use di for deinterlace"
	select MTK_NR
	help
		This enable use DI HW for video deinterlace
		Choose this option if you have a Mediatek SoCs.
	  	The module will be called mtk_vq_mgr
	  	This driver provides deinterlace function
	  	to userspace

config MTK_NR
	bool "use nr for noise reduction"
	help
		This enable use NR HW for video noise reduction
```

## kernel/mediatek/mt8696/4.14/drivers/phy/mediatek/Kconfig
```kconfig
#
# Phy drivers for Mediatek devices
#
config PHY_MTK_TPHY
    tristate "MediaTek T-PHY Driver"
    depends on ARCH_MEDIATEK && OF
    select GENERIC_PHY
    help
      Say 'Y' here to add support for MediaTek T-PHY driver,
      it supports multiple usb2.0, usb3.0 ports, PCIe and
	  SATA, and meanwhile supports two version T-PHY which have
	  different banks layout, the T-PHY with shared banks between
	  multi-ports is first version, otherwise is second veriosn,
	  so you can easily distinguish them by banks layout.

config PHY_MTK_USB3_I2C_FPGA
	tristate "Mediatek FPGA USB I2C Driver"
	depends on ARCH_MEDIATEK && OF
	select GENERIC_PHY
	help
	  Enable this to support for Mediatek USB 3.0 PHY I2c Interface driver,
	  MTK MD1122, MS0796 and so on.

	  It supports multiple usb 2.0 and usb 3.0 ports.
	  This i2c interface is internal bus special for Medaitek USB 3.0
	  PHY transceiver. In general, these daughter card is used
	  to develop or verify usb feature in FPGA environment.

config PHY_MTK_A60810
	tristate "Mediatek FPGA USB 2.0 PHY Driver"
	depends on ARCH_MEDIATEK && OF
	select PHY_MTK_USB3_I2C_FPGA
	help
	  Enable this to add support the transceiver that is Mediatek USB 2.0
	  MD1122 PHY daughter board driver with chip AT60810AG.

	  This driver controls the entire PHY block usb 2.0 PHYs.
	  And we use xHCI IP MAC module that MTK customered.

config PHY_MTK_A60931
	tristate "Mediatek FPGA USB 3.0 PHY Driver"
	depends on ARCH_MEDIATEK && OF
	select PHY_MTK_USB3_I2C_FPGA
	help
	  Enable this to add support the transceiver that is Mediatek USB 3.0
	  MS0796 PHY daughter board driver with chip A60931.

	  This driver controls the entire PHY block usb 3.0/2.0 PHYs.
	  And we use xHCI IP MAC module that MTK customered.

config PHY_MTK_A60XXX
	tristate "Mediatek FPGA USB 3.0 multi-PHY Driver"
	depends on ARCH_MEDIATEK && OF
	select PHY_MTK_USB3_I2C_FPGA
	help
	  Enable this to add support the transceiver that is Mediatek USB 3.0
	  MS0796 PHY daughter board driver with chip AT60810AG.
	  MD1122 PHY daughter board driver with chip A60931.

	  This driver controls the entire PHY block usb 3.0/2.0 PHYs.
	  And we use xHCI IP MAC module that MTK customered.
```
