## kernel/mediatek/mt8696/5.10/drivers/misc/mediatek/Kconfig
```kconfig
# SPDX-License-Identifier: GPL-2.0

menu "Storage"
source "drivers/misc/mediatek/pidmap/Kconfig"
endmenu # Storage

menu "Power, PMIC, Battery & Low Power"
source "drivers/misc/mediatek/clkbuf/Kconfig"
source "drivers/misc/mediatek/slbc/Kconfig"
source "drivers/misc/mediatek/cm_mgr/Kconfig"
source "drivers/misc/mediatek/mcupm/Kconfig"
source "drivers/misc/mediatek/dvfsrc/Kconfig"
source "drivers/misc/mediatek/dcm/Kconfig"
source "drivers/misc/mediatek/qos/Kconfig"
source "drivers/misc/mediatek/srclken_rc/Kconfig"
source "drivers/misc/mediatek/lpm/Kconfig"
source "drivers/misc/mediatek/ssc/Kconfig"
source "drivers/misc/mediatek/swpm/Kconfig"
source "drivers/misc/mediatek/power_throttling/Kconfig"
source "drivers/misc/mediatek/pmic_protect/Kconfig"
source "drivers/misc/mediatek/cpufreq_v1/Kconfig"
source "drivers/misc/mediatek/eemgpu/Kconfig"
source "drivers/misc/mediatek/leakage_table/Kconfig"
source "drivers/misc/mediatek/mdpm/Kconfig"
source "drivers/misc/mediatek/pbm/Kconfig"
source "drivers/misc/mediatek/pmsr/Kconfig"
source "drivers/misc/mediatek/power/Kconfig"
endmenu # Power

menu "MultiMedia, Display, Camera"
source "drivers/misc/mediatek/iommu/Kconfig"
source "drivers/misc/mediatek/cameraisp/Kconfig"
source "drivers/misc/mediatek/cmdq/Kconfig"
source "drivers/misc/mediatek/hdmi/Kconfig"
source "drivers/misc/mediatek/mtk-interconnect/Kconfig"
source "drivers/misc/mediatek/mdp/Kconfig"
source "drivers/misc/mediatek/debugfs_creator/Kconfig"
source "drivers/misc/mediatek/mmp/Kconfig"
source "drivers/misc/mediatek/lens/Kconfig"
source "drivers/misc/mediatek/flashlight/Kconfig"
source "drivers/misc/mediatek/flashlight/v4l2/Kconfig"
source "drivers/misc/mediatek/imgsensor/Kconfig"
source "drivers/misc/mediatek/jpeg/Kconfig"
source "drivers/misc/mediatek/cam_cal/Kconfig"
source "drivers/misc/mediatek/cam_timesync/Kconfig"
source "drivers/misc/mediatek/camera_mem/Kconfig"
source "drivers/misc/mediatek/vow/Kconfig"
source "drivers/misc/mediatek/ccu/src/Kconfig"
source "drivers/misc/mediatek/vdec_fmt/Kconfig"
source "drivers/misc/mediatek/widevine_drm/Kconfig"
source "drivers/misc/mediatek/mminfra/Kconfig"
source "drivers/misc/mediatek/sync/Kconfig"
source "drivers/misc/mediatek/video/Kconfig"
source "drivers/misc/mediatek/systracker/Kconfig"
source "drivers/misc/mediatek/slbc/Kconfig"
source "drivers/misc/mediatek/vq/Kconfig"
endmenu # MultiMedia, Display, Camera

menu "Security"

config MTK_TEE_GP_SUPPORT
       bool "Enable MTK GlobalPlatform support in TEE related modules"
       default n
       depends on (TRUSTONIC_TEE_SUPPORT) || (MICROTRUST_TEE_SUPPORT) || \
                  (TEE)
       help
         GlobalPlatform defines common/consistent APIs and this option
         enables TEE related modules to use GPAPIs. (depending on
         Trustonic TEE Support or Microtrust TEE Support or Google Trusty
         TEE or other 3rd-party TEE)

source "drivers/misc/mediatek/trusted_mem/Kconfig"
source "drivers/misc/mediatek/geniezone/Kconfig"
source "drivers/misc/mediatek/secure_efuse/Kconfig"
source "drivers/misc/mediatek/masp/Kconfig"
source "drivers/misc/mediatek/mkp/Kconfig"
source "drivers/misc/mediatek/mtee/Kconfig"
endmenu # Security

menu "Tinysys"
source "drivers/misc/mediatek/apusys/Kconfig"
source "drivers/misc/mediatek/sspm/Kconfig"
source "drivers/misc/mediatek/tinysys_scmi/Kconfig"
source "drivers/misc/mediatek/scp/Kconfig"
source "drivers/misc/mediatek/vcp/Kconfig"
endmenu # Tinysys

menu "Debug, log, trace"

config MTK_MET
	tristate "MET FEATURE ENABLE"
	help
	  This selects the MET profile function for MET device.
	  If you want MET feature, say m here.
	  This is needed if support for MET devices is required.
	  If unsure, say N.

config MTK_MET_DEBUG
	bool "MET DEBUG"
	depends on MTK_MET
	help
	  To prevent abi violation, we introduce MET DEBUG config
	  for those MET features enabled only in eng/userdebug build.
	  Say Y in eng/userdebug build.
	  If unsure, say N.

config MTK_MET_RESERVED_MEM_BY_TINYSYS
	bool "MET RESERVED MEM BY TINYSYS"
	depends on MTK_MET
	help
		to decide that MET alloc reserved dram memory by self or other module
		MET alloc the reserved memory at preloader stage
		tinysys alloc the reserved memory at kernel
		IF unsure, set N

config MTK_MET_SSPM_LEGACY_IPI
	bool "MTK MET SSPM USELEGACY IPI"
	depends on MTK_MET
	help
		This select decide that MET module use legacy ipi or not
		some product use another method is scmi protocal
		the legacy project use the ipi method usually
		this option depend on sspm module implement method
		if unsure, set N


source "drivers/misc/mediatek/blocktag/Kconfig"
source "drivers/misc/mediatek/mtprof/Kconfig"
source "drivers/misc/mediatek/locking/Kconfig"
source "drivers/misc/mediatek/mmstat/Kconfig"
source "drivers/misc/mediatek/aee/Kconfig"
source "drivers/misc/mediatek/atf/Kconfig"
source "drivers/misc/mediatek/sda/Kconfig"
source "drivers/misc/mediatek/subpmic/Kconfig"
source "drivers/misc/mediatek/monitor_hang/Kconfig"
source "drivers/misc/mediatek/log_store/Kconfig"
source "drivers/misc/mediatek/mtprintk/Kconfig"
source "drivers/misc/mediatek/selinux_warning/Kconfig"
source "drivers/misc/mediatek/ice_debug/Kconfig"
source "drivers/misc/mediatek/debug_tracer/Kconfig"
source "drivers/misc/mediatek/dfd/Kconfig"
endmenu # Debug

menu "Modem & Connectivity"
source "drivers/misc/mediatek/ccci_util/Kconfig"
source "drivers/misc/mediatek/ccmni/Kconfig"
source "drivers/misc/mediatek/eccci/Kconfig"
source "drivers/misc/mediatek/btif/Kconfig"
source "drivers/misc/mediatek/connectivity/Kconfig"
source "drivers/misc/mediatek/conn_md/Kconfig"
source "drivers/misc/mediatek/conn_scp/Kconfig"
source "drivers/misc/mediatek/nfc/Kconfig"
source "drivers/misc/mediatek/memory-amms/Kconfig"
source "drivers/misc/mediatek/mddp/Kconfig"
endmenu # Modem

menu "Other Peripherals"
source "drivers/misc/mediatek/rt-regmap/Kconfig"
source "drivers/misc/mediatek/typec/Kconfig"
source "drivers/misc/mediatek/extcon/Kconfig"
source "drivers/misc/mediatek/usb_mtp/Kconfig"
source "drivers/misc/mediatek/usb_boost/Kconfig"
source "drivers/misc/mediatek/usb_meta/Kconfig"
source "drivers/misc/mediatek/irtx/Kconfig"
source "drivers/misc/mediatek/pwm/Kconfig"
source "drivers/misc/mediatek/sensor/Kconfig"
source "drivers/misc/mediatek/sensors-1.0/Kconfig"
source "drivers/misc/mediatek/gate_ic/Kconfig"
source "drivers/misc/mediatek/asrc/Kconfig"
source "drivers/misc/mediatek/irrx/Kconfig"
endmenu # Other Peripheral

menu "Performance"
source "drivers/misc/mediatek/sched/Kconfig"
source "drivers/misc/mediatek/cache-auditor/Kconfig"
source "drivers/misc/mediatek/performance/Kconfig"
source "drivers/misc/mediatek/perf_common/Kconfig"
source "drivers/misc/mediatek/rps/Kconfig"
source "drivers/misc/mediatek/task_turbo/Kconfig"
endmenu # Performance

menu "Config File"
config BUILD_CONFIG_FILE
	string "build config file"
	help
	  Specify the build.config file which record toolchain environment
	  Such as "build.config.mtk.aarch64"

config ABI_MONITOR
	bool "abi monitor support"
	help
	  Used to enable abi monitor check for KMI,
	  which is the interface between kernel modules and kernel(vmlinux).
	  Say Y here if you are need abi monitor support.
	  If unsure, say N

config EXT_MODULES
	string "out-of-tree kernel modules"
	help
	  Specify out-of-tree kernel modules to build in order
	  The value must be kernel module repo list, such as
	  "vendor/mediatek/kernel_modules_mt8696/connectivity/common vendor/mediatek/kernel_modules_mt8696/connectivity/gps"
endmenu # Config

config MTK_LDVT_SUPPORT
        bool "MTK Linux DVT Environment Support"
        help
          This enables MTK LDVT (Linux DVT) Environment Support.
          DVT means IC Design Validation Test, so LDVT is Linux
          OS test environment to verify HW modules, such as USB,
          Ethernet, etc.

source "drivers/misc/mediatek/ldvt/Kconfig"

menu "Misc configs"

source "drivers/misc/mediatek/stc/Kconfig"

config FPGA_EARLY_PORTING
	bool "MTK FPGA EARLY PORTING"
	help
	  Used for FPGA early porting to separate code segments between FPGA
	  platform and non-FPGA platform.
	  Say Y here if you are doing FPGA early porting.
	  If unsure, say N
endmenu # Misc

config MTK_SEC_VIDEO_PATH_SUPPORT
	bool "Enable MTK Secure Video Path Support"
	depends on MTK_IN_HOUSE_TEE_SUPPORT || TRUSTONIC_TEE_SUPPORT || \
	           MTK_GOOGLE_TRUSTY_SUPPORT || MICROTRUST_TEE_SUPPORT || \
	           OPTEE
	help
	  This enable MTK Secure Video Path function of Widevine Level1,
	  HW protect the online secure video streaming by ARM/Trustzone
	  support TEE OS of: Trustonic, Microtrust, Blowfish .etc
	  relative modules include: DRM, vdec, venc, cmdq, m4u, display,
	  tplay/DXCC,ssvp, secmem, TEE frameworks, keyinstall, DAPC, MPU,
	  ION, gralloc,RPMB, DXCC, mediacodec, WFD, MDP.etc
	  relative options including: MTK_TEE_SUPPORT, MTK_GP_SUPPORT,
	  MTK_DRM_L1_SUPPORT, MTK_PERSIST_PARTITION_SUPPORT,
	  MTK_DRM_KEY_MNG_SUPPORT.
```

## kernel/mediatek/mt8696/5.10/drivers/misc/mediatek/cm_mgr/Kconfig
```kconfig
config MTK_CM_MGR
	tristate "MTK CPU Memory Latency Management"
	help
	  This kernel config can be used to enable CM_MGR. When enable
	  this option, dram opp level will be changed which will depended
	  on power table.
	  If unsure, say N.

config MTK_CM_IPI
	tristate "MTK CM use IPI"
	help
	  This kernel config can be used to enable CM IPI. When enable
	  this option, we will use ipi on system buffer to improve
	  performance and power.
	  If unsure, say N.

config MTK_CM_MGR_LEGACY
	tristate "MTK CM_MGR for LEGACY"
	help
	  This kernel config can be used to enable CM_MGR. When enable
	  this option, dram opp level will be changed which will depended
	  on power table.
	  If unsure, say N.
```

## kernel/mediatek/mt8696/5.10/drivers/misc/mediatek/mdp/Kconfig
```kconfig
config MTK_MDP
	bool "use imgresz rotate for scale & rotate"
	help
	  This option enable imgresz hardware.
	  imgresz HW is used for scale down picture & rotate.
	  MDP software provide ioctl API for
	  userspace HWC & GPU use imgresz.

config MTK_CLI_DEBUG_SUPPORT
	bool "enable cli feature for debug"
	help
		This config enable cli command for debug mdp / vdp.
```

## kernel/mediatek/mt8696/5.10/drivers/misc/mediatek/mdp/imgresz/Kconfig
```kconfig
config MTK_IMGRZ_TEST
    bool "unit test of imgrz driver"
    default y
    help
	This option enabel imgrz unit test.
	USAGE: echo [ACTION]>/d/imgresz
	Test mode: OSD/JPEG/VIDEO mode
	Depend on debugfs.

config MTK_IMGRZ_TEST_PA
    bool "use pa for unit test of imgrz driver"
    default n
    help
	imgrz driver support unit test by pa.
```

## kernel/mediatek/mt8696/5.10/drivers/misc/mediatek/rt-regmap/Kconfig
```kconfig
# SPDX-License-Identifier: GPL-2.0

config RT_REGMAP
	bool "Richtek regmap"
	default n
	help
	  Say Y to enable Richtek regmap
	  Interface for register debug node and ops.
	  This config decide to use regmap easy
	  for debug in RT chip.
```

## kernel/mediatek/mt8696/5.10/drivers/misc/mediatek/sensors-1.0/hwmon/Kconfig
```kconfig
config MTK_HWMON
	tristate "MTK HWMON Config"
	help
	  CONFIG_MTK_HWMON for sensor common util
```

## kernel/mediatek/mt8696/5.10/drivers/misc/mediatek/stc/Kconfig
```kconfig
config MTK_STC
	bool "Enable MediaTek STC counter"
	help
	  MTK STC counter is working for audio and video syncing.
	  Set Y to enable stc counter.
```

## kernel/mediatek/mt8696/5.10/drivers/net/ethernet/mediatek/Kconfig
```kconfig
# SPDX-License-Identifier: GPL-2.0-only
config NET_VENDOR_MEDIATEK
	bool "MediaTek devices"
	depends on ARCH_MEDIATEK || SOC_MT7621 || SOC_MT7620
	help
	  If you have a Mediatek SoC with ethernet, say Y.

if NET_VENDOR_MEDIATEK

config NET_MEDIATEK_SOC
	tristate "MediaTek SoC Gigabit Ethernet support"
	select PHYLINK
	help
	  This driver supports the gigabit ethernet MACs in the
	  MediaTek SoC family.

config NET_MEDIATEK_STAR_EMAC
	tristate "MediaTek STAR Ethernet MAC support"
	select PHYLIB
	select REGMAP_MMIO
	help
	  This driver supports the ethernet MAC IP first used on
	  MediaTek MT85** SoCs.

config MEDIATEK_ETH_DEBUG
	bool "Debug Ethernet support"
	depends on NET_MEDIATEK_STAR_EMAC
	help
	  This enables Ethernet debug support. Switch ethernet debug
	  function by MEDIATEK_ETH_DEBUG control. It will add Ethernet
	  read and write functions to facilitate the operation of mac
	  and phy registers for debugging.

endif #NET_VENDOR_MEDIATEK
```

## kernel/mediatek/mt8696/5.10/drivers/phy/mediatek/Kconfig
```kconfig
# SPDX-License-Identifier: GPL-2.0-only
#
# Phy drivers for Mediatek devices
#
config PHY_MTK_TPHY
	tristate "MediaTek T-PHY Driver"
	depends on ARCH_MEDIATEK || COMPILE_TEST
	depends on OF
	select GENERIC_PHY
	help
	  Say 'Y' here to add support for MediaTek T-PHY driver,
	  it supports multiple usb2.0, usb3.0 ports, PCIe and
	  SATA, and meanwhile supports two version T-PHY which have
	  different banks layout, the T-PHY with shared banks between
	  multi-ports is first version, otherwise is second version,
	  so you can easily distinguish them by banks layout.

config PHY_MTK_UFS
	tristate "MediaTek UFS M-PHY driver"
	depends on ARCH_MEDIATEK || COMPILE_TEST
	depends on OF
	select GENERIC_PHY
	help
	  Support for UFS M-PHY on MediaTek chipsets.
	  Enable this to provide vendor-specific probing,
	  initialization, power on and power off flow of
	  specified M-PHYs.

config PHY_MTK_XSPHY
	tristate "MediaTek XS-PHY Driver"
	depends on ARCH_MEDIATEK || COMPILE_TEST
	depends on OF
	select GENERIC_PHY
	help
	  Enable this to support the SuperSpeedPlus XS-PHY transceiver for
	  USB3.1 GEN2 controllers on MediaTek chips. The driver supports
	  multiple USB2.0, USB3.1 GEN2 ports.

config PHY_MTK_HDMI
	tristate "MediaTek HDMI-PHY Driver"
	depends on ARCH_MEDIATEK || COMPILE_TEST
	depends on COMMON_CLK
	depends on OF
	select GENERIC_PHY
	help
	  Support HDMI PHY for Mediatek SoCs.

config PHY_MTK_FPGAPHY
	tristate "MediaTek FPGA-PHY Driver"
	depends on ARCH_MEDIATEK || COMPILE_TEST
	depends on OF
	select GENERIC_PHY
	help
	  Enable this to support A60931/A60810 FPGA PHY.
 
config PHY_MTK_USB3_I2C_FPGA
	tristate "Mediatek FPGA USB I2C Driver"
	depends on ARCH_MEDIATEK && OF
	select GENERIC_PHY
	help
	  Enable this to support for Mediatek USB 3.0 PHY I2c Interface driver,
	  MTK MD1122, MS0796 and so on.

	  It supports multiple usb 2.0 and usb 3.0 ports.
	  This i2c interface is internal bus special for Medaitek USB 3.0
	  PHY transceiver. In general, these daughter card is used
	  to develop or verify usb feature in FPGA environment.

config PHY_MTK_A60810
	tristate "Mediatek FPGA USB 2.0 PHY Driver"
	depends on ARCH_MEDIATEK && OF
	select PHY_MTK_USB3_I2C_FPGA
	help
	  Enable this to add support the transceiver that is Mediatek USB 2.0
	  MD1122 PHY daughter board driver with chip AT60810AG.

	  This driver controls the entire PHY block usb 2.0 PHYs.
	  And we use xHCI IP MAC module that MTK customered.

config PHY_MTK_A60931
	tristate "Mediatek FPGA USB 3.0 PHY Driver"
	depends on ARCH_MEDIATEK && OF
	select PHY_MTK_USB3_I2C_FPGA
	help
	  Enable this to add support the transceiver that is Mediatek USB 3.0
	  MS0796 PHY daughter board driver with chip A60931.

	  This driver controls the entire PHY block usb 3.0/2.0 PHYs.
	  And we use xHCI IP MAC module that MTK customered.

config PHY_MTK_A60XXX
	tristate "Mediatek FPGA USB 3.0 multi-PHY Driver"
	depends on ARCH_MEDIATEK && OF
	select PHY_MTK_USB3_I2C_FPGA
	help
	  Enable this to add support the transceiver that is Mediatek USB 3.0
	  MS0796 PHY daughter board driver with chip AT60810AG.
	  MD1122 PHY daughter board driver with chip A60931.

	  This driver controls the entire PHY block usb 3.0/2.0 PHYs.
	  And we use xHCI IP MAC module that MTK customered.

config PHY_MTK_DP
	tristate "MediaTek DP-PHY Driver"
	depends on ARCH_MEDIATEK || COMPILE_TEST
	depends on OF
	select GENERIC_PHY
	help
	  Support DisplayPort PHY for Mediatek SoCs.
```
